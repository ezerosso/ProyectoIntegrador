#include <Arduino.h>
#include <Wire.h>
#include <SD.h>
#include <PMS.h>
#include <Adafruit_GFX.h>
#include <Adafruit_SH110X.h>
#include <DHT.h>
#include <TinyGPSPlus.h>
#include <SoftwareSerial.h>

// Sensor PM:
PMS pms(Serial);
PMS::DATA data; //:: es el operador de resulución de ámbito

// Sensor T/RH:
DHT dht(D4, DHT22);

// OLED:
#define i2c_Address 0x3C
#define SCREEN_WIDTH 128 // OLED display width, in pixels
#define SCREEN_HEIGHT 64 // OLED display height, in pixels
#define OLED_RESET -1    //   QT-PY / XIAO

Adafruit_SH1106G display = Adafruit_SH1106G(SCREEN_WIDTH, SCREEN_HEIGHT, &Wire, OLED_RESET);

// mapa de bits 'logoUNC', 128x64px
const unsigned char logoUNC[] PROGMEM = {
    0xff, 0xff, 0xff, 0xff, 0xff, 0xff, 0xff, 0xff, 0xf0, 0x00, 0x00, 0x00, 0x00, 0x00, 0x00, 0x00,
    0xff, 0xff, 0xff, 0xff, 0xff, 0xff, 0xff, 0xff, 0xf0, 0x00, 0x00, 0x00, 0x00, 0x00, 0x00, 0x00,
    0xff, 0xff, 0xff, 0xff, 0xff, 0xff, 0xff, 0xff, 0xf0, 0x00, 0x00, 0x00, 0x00, 0x00, 0x00, 0x00,
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    0xff, 0xff, 0xff, 0xff, 0xff, 0xff, 0xff, 0xff, 0xf0, 0x00, 0x00, 0x00, 0x00, 0x00, 0x00, 0x00};

// mapa de bits pantalla principal, 127x64px
const unsigned char pantallaGeneral [] PROGMEM = {
	0x00, 0x00, 0x00, 0x00, 0x00, 0x00, 0x00, 0x00, 0x00, 0x00, 0x00, 0x00, 0x00, 0x00, 0x00, 0x00, 
	0x3f, 0xff, 0xf8, 0x00, 0x00, 0x00, 0x00, 0x00, 0x00, 0x00, 0x00, 0x00, 0x00, 0x00, 0x00, 0x00, 
	0x20, 0x00, 0x08, 0x00, 0x00, 0x00, 0x00, 0x00, 0x00, 0x00, 0x00, 0x00, 0x00, 0x00, 0x00, 0x00, 
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	0x00, 0x00, 0x00, 0x00, 0x00, 0x00, 0x00, 0x00, 0x00, 0x00, 0x00, 0x00, 0x00, 0x00, 0x00, 0x00
};

// GPS:
static const int RXPin = D3;
SoftwareSerial Serial_GPS(RXPin); // TXPin = -1 (default) for onewire protocol, GPIO pin used for twowire TX.
TinyGPSPlus gps;

// SD:
const int chipSelect = D8;
File dataFile;

// Declaración de funciones:
void iniciarSerial();
void iniciarLED();
void iniciarOLED();
void iniciarSD();
void iniciarTRH();
void limpiarBuffer();
void estabilizarSensorPM();
void informarEstabilizacion();
void pantallaInicio();
void pantallaPrincipal();
void imprimirDatos();
void imprimirPM();
void imprimirTRH();
void medirBateria();
void informarBajaBateria();
void leerPM();
void leerGPS();
void guardarDatosGPS();
void leerTRH();
void guardarDatosSD();
String coregirDatosGPS(uint8_t dato);
void writeTextOLED(uint8_t tamanio, uint16_t x, uint16_t y, const char *texto);
void comprobarGPS();
void informarFallaSD();
void informarBusquedaSatelite();
void buscarSateliteGPS();
void informarFallaGPS();
void informarFallaPM();
// void informarFallaTRH();
void ledOn();
void ledOff();
void ledToggle();

/*Variables:*/

// Ubicación:
double latitud;
double longitud;
double altitud;
// Fecha:
uint8_t dia;
uint8_t mes;
uint8_t año;
// Horario:
uint8_t hora;
uint8_t minutos;
uint8_t segundos;
// Sensor PM:
uint16_t PM1;
uint16_t PM2_5;
uint16_t PM10;
// Sensor T/RH:
float temperatura;
float humedad;
// Debug

unsigned long tiempoInicialGPS = 0;

uint8_t flagSD = 0;

uint8_t xSat = 0;

bool ledStatus = false;
bool bateriaBaja = false;
bool fallaTRH=false;

uint32_t tiempoInicialPrograma =0;

// Datos:
// String dataString;
String nameDataString;

void setup() {
  iniciarSerial();
  iniciarLED();
  iniciarTRH();
  iniciarOLED();
  pantallaInicio();
  digitalWrite(D0, HIGH); // Enciende sensor T/RH
  iniciarSD();
  buscarSateliteGPS();
  limpiarBuffer();
  estabilizarSensorPM();
  pantallaPrincipal();
}

void loop() {
  medirBateria();
  leerGPS();
  leerPM();
  leerTRH();
  guardarDatosSD();
  if (!bateriaBaja) {
    imprimirDatos();
  }
}

void iniciarSerial() {
  Serial.begin(9600, SERIAL_8N1, SERIAL_RX_ONLY); // Inicialización de puerto UART para recepción de PMS5003
  Serial_GPS.begin(9600);                         // Inicialización de Software Serial para recepción de GPS ublox
  while(!Serial && !Serial_GPS);
}

void iniciarLED() {
  pinMode(D10, OUTPUT); //Pin del LED
  digitalWrite(D10, LOW);
}

void iniciarOLED() {
  display.begin(i2c_Address, true);
  display.clearDisplay();
}

void pantallaInicio() {
  display.drawBitmap(0, 0, logoUNC, 128, 64, SH110X_BLACK, SH110X_WHITE);
  display.display();
  delay(2000);
  display.clearDisplay();
  display.setTextSize(2);
  display.setTextColor(SH110X_WHITE);
  display.setCursor(5, 10);
  display.println("MONITOR");
  display.setTextSize(3);
  display.setCursor(30, 30);
  display.println("PM");
  display.fillCircle(95 + 15, 20, 17, SH110X_WHITE);
  display.fillCircle(69 + 15, 50, 10, SH110X_WHITE);
  display.fillCircle(93 + 15, 50, 5, SH110X_WHITE);
  display.display();
  delay(1000);
  for (int8_t i = 0; i < 120; i++) {
    display.fillCircle(93 + 15, 50, i, SH110X_WHITE);
    display.display();
  }
  display.clearDisplay();
}

void iniciarSD() {
  if (!SD.begin(chipSelect)) {
    informarFallaSD();
    while (!SD.begin(chipSelect)) {
      ledOn();
      delay(500);
      ledOff();
      delay(500);
    }
  }
}

void iniciarTRH() {
  dht.begin(); // Inicialización de sensor T/RH DHT22
  pinMode(D0, OUTPUT);
  digitalWrite(D0, LOW);
  // delay(2000);
  // digitalWrite(D0, HIGH); // Enciende sensor T/RH
}

void limpiarBuffer(){
    while (Serial.available() || Serial_GPS.available())//Limpia el buffer de los seriales
  {
    Serial.read();
    Serial_GPS.read();
  }
}

void estabilizarSensorPM() {
    unsigned long tiempoDeInicio = millis();
    if(tiempoDeInicio < 30000) {
        informarEstabilizacion();
        delay(30000 - tiempoDeInicio);
    }
}

void informarEstabilizacion() {
  display.clearDisplay();
  writeTextOLED(2, 13, 11, "ESPERANDO");
  writeTextOLED(2, 32, 30, "SENSOR");
  writeTextOLED(2, 49, 49, "PM");
}

void imprimirDatos() {
  imprimirPM();
  imprimirTRH();
}

void imprimirPM() {
  display.fillRect(5, 24, 49, 22, SH110X_WHITE);
  display.setTextColor(SH110X_BLACK);
  display.setTextSize(2);

  if(PM2_5 < 10) {
    display.setCursor(23, 29);
  }
  else if(PM2_5 >= 10 && PM2_5 < 100){
    display.setCursor(18, 29);
  }
  else if(PM2_5 >= 100 && PM2_5 <= 1000){
    display.setCursor(13, 29);
  }
  else {
    display.setCursor(7, 29);
  }
  
  display.println(PM2_5);
  display.display();
}

void imprimirTRH() {
    display.fillRect(60, 4, 32, 55, SH110X_BLACK);
    display.setTextColor(SH110X_WHITE);
    display.setTextSize(2);

    if(fallaTRH) {
      display.setCursor(67, 9);
      display.print("X");
      display.setCursor(67, 41);
      display.println("X");
      display.display();
    } else {
      int h_int = static_cast<int>(humedad);
      int t_int = static_cast<int>(temperatura);
      display.setCursor(67, 9);
      display.print(h_int);
      display.setCursor(67, 41);
      display.println(t_int);
      display.display();
    }
}

void pantallaPrincipal() {
  display.drawBitmap(0, 0, pantallaGeneral, 128, 64, SH110X_WHITE, SH110X_BLACK);
  display.display();
}

void medirBateria() {
  if(bateriaBaja) {
    return;
  }
  float lectura = analogRead(A0);
  float volt = (lectura / 1023) * 4.2;
  // Serial.println(volt);
  if (volt >= 3.7) {
    // CARGA COMPLETA
    display.fillRect(4, 3, 3, 4, SH110X_WHITE);
    display.fillRect(8, 3, 3, 4, SH110X_WHITE);
    display.fillRect(12, 3, 3, 4, SH110X_WHITE);
    display.fillRect(16, 3, 3, 4, SH110X_WHITE);
    display.display();
  }
  else if (volt < 3.7 && volt > 3.6) {
    // CARGA 3/4
    display.fillRect(4, 3, 3, 4, SH110X_BLACK);
    display.fillRect(8, 3, 3, 4, SH110X_WHITE);
    display.fillRect(12, 3, 3, 4, SH110X_WHITE);
    display.fillRect(16, 3, 3, 4, SH110X_WHITE);
    display.display();
  }
  else if (volt < 3.6 && volt > 3.5)
  {
    // CARGA 2/4
    display.fillRect(4, 3, 3, 4, SH110X_BLACK);
    display.fillRect(8, 3, 3, 4, SH110X_BLACK);
    display.fillRect(12, 3, 3, 4, SH110X_WHITE);
    display.fillRect(16, 3, 3, 4, SH110X_WHITE);
    display.display();
  }
  else if (volt < 3.5 && volt > 3.3)
  {
    // CARGA 1/4: INFORMAR BAJA BATERÍA EN LA PANTALLA Y PARPADEO DE LED.
    // SEGUIR SENSANDO PERO NO MOSTRARLO, SOLO SEGUIR INFORMANDO LA BAJA BATA.
    display.fillRect(4, 3, 3, 4, SH110X_BLACK);
    display.fillRect(8, 3, 3, 4, SH110X_BLACK);
    display.fillRect(12, 3, 3, 4, SH110X_BLACK);
    display.fillRect(16, 3, 3, 4, SH110X_WHITE);
    display.display();
  }
  else {
    informarBajaBateria();
  }
}

void informarBajaBateria() {
  display.clearDisplay();
  writeTextOLED(2, 25, 15, "BATERIA");
  writeTextOLED(2, 42, 36, "BAJA");

  ledOn();
  delay(500);
  ledOff();
  delay(500);
  ledOn();
  delay(500);
  ledOff();
  delay(500);
  ledOn();

  bateriaBaja = true;
}

void leerGPS() {
  comprobarGPS();
  tiempoInicialGPS = millis();
  while (true) {
    while (Serial_GPS.available() > 0) {
      if (gps.encode(Serial_GPS.read()) && gps.time.isUpdated()) {
        guardarDatosGPS();
        return;
      }
    }
    if ((millis() - tiempoInicialGPS) > 1000) { //REVISAR: debe haber una falla en esto porque el equipo en un momento se clavó entre la pantalla principal y la información de la falla del modulo GPS
      buscarSateliteGPS();
      pantallaPrincipal();
      tiempoInicialGPS = millis();              //LE CAMBIE ESTO CON RESPECTO A LA REVISION QUE ESPECIFIQUE ARRIBA.
    }
  }
}

void guardarDatosGPS() {
  // Ubicación:
  if (gps.location.isValid() /* && gps.location.isUpdated() */) {
    latitud = gps.location.lat();
    longitud = gps.location.lng();
    altitud = gps.altitude.meters();
  }
  else {
    buscarSateliteGPS();
    pantallaPrincipal();
    latitud = gps.location.lat();
    longitud = gps.location.lng();
    altitud = gps.altitude.meters();
  }
  // Fecha:
  if (gps.date.isValid() /* && gps.date.isUpdated() */) {
    dia = gps.date.day();
    mes = gps.date.month();
    año = gps.date.year();
  }
  // Horario:
  if (gps.time.isValid() /* && gps.time.isUpdated() */) {
    hora = gps.time.hour();
    minutos = gps.time.minute();
    segundos = gps.time.second();
  }
  else {
    segundos++;
    // Serial.println(F("INVALID time"));
  }
}

void leerPM() {
  if (pms.readUntil(data)) {
    PM1 = data.PM_AE_UG_1_0;
    PM2_5 = data.PM_AE_UG_2_5;
    PM10 = data.PM_AE_UG_10_0;
  }
  else {
    informarFallaPM();
    while (Serial.available()==0) {
      ledOn();
      delay(500);
      ledOff();
      delay(500);
    }
    pantallaPrincipal();
    leerPM();
  }
}

void leerTRH() {
  temperatura = dht.readTemperature();
  humedad = dht.readHumidity();
  if (isnan(humedad) || isnan(temperatura)) {
      ledOn();
      fallaTRH = true;
  } else {
      ledOff();
      fallaTRH = false;
  }
}

void guardarDatosSD() {
  if (hora <= 2) {
    hora = 24 + hora;
    dia -= 1;
  }
  String diaCorregido = coregirDatosGPS(dia);
  String mesCorregido = coregirDatosGPS(mes);
  String añoCorregido = String(año - 208);
  String horaCorregido = coregirDatosGPS(hora - 3);
  String minutosCorregido = coregirDatosGPS(minutos);
  String segundosCorregido = coregirDatosGPS(segundos);
  nameDataString = "MonitorPM_" + diaCorregido + "-" + mesCorregido + "-" + añoCorregido + ".csv";
  
  if(!SD.exists(nameDataString)) {
    dataFile = SD.open(nameDataString, FILE_WRITE);
    dataFile.println("Latitud;Longitud;Altitud;Fecha;Horario;PM1.0;PM2.5;PM10;Temperatura;Humedad");
    dataFile.close();
  }

  dataFile = SD.open(nameDataString, FILE_WRITE);
  
  while(!dataFile){
    informarFallaSD();
    while(!dataFile) {
      delay(500);
      iniciarSD();
      dataFile = SD.open(nameDataString, FILE_WRITE);
      ledToggle();
    }
  }

  String dataString = String(latitud, 6) + ";" + String(longitud, 6) + ";" + String(altitud, 6) + ";" + diaCorregido + "/" + mesCorregido + "/" + añoCorregido + ";" + horaCorregido + ":" + minutosCorregido + ":" + segundosCorregido + ";" + String(PM1) + ";" + String(PM2_5) + ";" + String(PM10) + ";" + String(temperatura) + ";" + String(humedad);
  dataFile.println(dataString);
  dataFile.close();
}

String coregirDatosGPS(uint8_t dato) {
  if (dato < 10) {
    return "0" + String(dato);
  }
  else {
    return String(dato);
  }
}

void writeTextOLED(uint8_t tamanio, uint16_t x, uint16_t y, const char *texto) {
  // display.clearDisplay();
  display.setTextSize(tamanio);
  display.setTextColor(SH110X_WHITE);
  display.setCursor(x, y);
  display.println(texto);
  display.display();
}

void informarFallaSD() {
  display.clearDisplay();
  writeTextOLED(2, 6, 4, "TARJETA SD");
  writeTextOLED(2, 53, 27, "NO");
  writeTextOLED(2, 6, 48, "ENCONTRADA");
}

void buscarSateliteGPS() {
  comprobarGPS();

  display.clearDisplay();
  writeTextOLED(2, 18, 4, "BUSCANDO");
  writeTextOLED(2, 12, 48, "SATELITES");
  limpiarBuffer();
  while(Serial_GPS.available()==0);
  while (true) {
    while ((Serial_GPS.available() > 0) && gps.encode(Serial_GPS.read())) {
      if (!ledStatus) {
        ledOn();
      }

      if (!gps.location.isValid()) {
        informarBusquedaSatelite();
      }
      else {
        ledOff();
        // pantallaPrincipal();
        return;
      }
    }
    if (ledStatus) {
      ledOff();
    }
  }
}

void comprobarGPS() {
  if (Serial_GPS.available() == 0)
  {
    informarFallaGPS();
    while (Serial_GPS.available() == 0)
    {
      ledOn();
      delay(500);
      ledOff();
      delay(500);
    }
    pantallaPrincipal();
  }
}

void informarFallaGPS() {
  display.clearDisplay();
  writeTextOLED(2, 6, 4, "MODULO GPS");
  writeTextOLED(2, 53, 27, "NO");
  writeTextOLED(2, 6, 48, "ENCONTRADO");
}

void informarBusquedaSatelite() {
  // static uint8_t xSat = 0;
  display.fillCircle(xSat, 32, 6, SH110X_BLACK);
  xSat += 6;
  if (xSat > 128)
    xSat = 0;
  display.fillCircle(xSat, 32, 6, SH110X_WHITE);
  display.display();
}

void informarFallaPM() {
  display.clearDisplay();
  writeTextOLED(2, 6, 4, "SENSOR PM");
  writeTextOLED(2, 53, 27, "NO");
  writeTextOLED(2, 6, 48, "ENCONTRADO");
  ledOn();
}

// void informarFallaTRH() {
//   display.clearDisplay();
//   writeTextOLED(2, 6, 4, "SENSOR T/RH");
//   writeTextOLED(2, 53, 27, "NO");
//   writeTextOLED(2, 6, 48, "ENCONTRADO");
// }

void ledOn() {
  digitalWrite(D10, HIGH);
  ledStatus = true;
}

void ledOff() {
  digitalWrite(D10, LOW);
  ledStatus = false;
}

void ledToggle() {
  if (ledStatus) {
    ledOff();
  }
  else {
    ledOn();
  }
}